// Phase 3 — OTA over cellular + remote logs
//
// Same cycle as Phase 2 (wake → modem on → network → GPS → MQTT publish →
// modem off → sleep), plus:
//   • Remote logs: every log line also goes into an RTC-memory buffer that is
//     published to devices/<id>/log. RTC memory survives resets, crashes and
//     deep sleep, so the log of a cycle that died is uploaded by the next one.
//   • OTA pull: after publishing, fetch manifest.txt from the VPS; if it names
//     another build, stream it into the spare OTA slot (MD5-checked) and
//     reboot into it.
//   • Probation: a freshly installed build confirms itself only after it has
//     published. A crash, watchdog reset or failed cycle makes the bootloader
//     roll back to the previous build, which refuses that build after two
//     failures (no download loop).
//
//   • Remote config: the retained devices/<id>/config document (set with
//     tools/set_config.py) is read on every wake, validated, kept in NVS and
//     acknowledged on devices/<id>/ack.
//   • Emergency mode (config mode=emergency): stay online with GPS running
//     and report every emergency_interval_s until the mode is cleared.
//
// Build/publish with tools/deploy_ota.sh (partition scheme min_spiffs: two
// 1.9 MB OTA slots). Libraries: TinyGSM, PubSubClient, ArduinoHttpClient,
// ArduinoJson

#define TINY_GSM_MODEM_SIM7600
#define TINY_GSM_RX_BUFFER 1024   // default 64 B makes downloads crawl
#include <TinyGsmClient.h>
#include <PubSubClient.h>
#include <ArduinoHttpClient.h>
#include <ArduinoJson.h>
#include <Update.h>
#include <Preferences.h>
#include <esp_ota_ops.h>
#include <esp_task_wdt.h>

#include "secrets.h"              // endpoints + credentials, generated by tools/deploy_ota.sh
#if __has_include("build_id.h")
#include "build_id.h"             // FW_BUILD, generated by tools/deploy_ota.sh
#else
#define FW_BUILD "dev"            // hand-built: reports, but never self-updates
#endif

// ── Pins (LilyGO T-SIM7600G-H, per LilyGo-Modem-Series utilities.h) ──
#define PWRKEY_PIN     4    // NPN driver: HIGH = PWRKEY low (≥100ms on, ≥2.5s off)
#define MODEM_TX_PIN  27    // ESP32 TX → modem RXD (via DIP switch 1)
#define MODEM_RX_PIN  26    // ESP32 RX ← modem TXD (via DIP switch 2)
#define DTR_PIN       32    // hold LOW so modem stays awake (not in UART sleep)
#define STATUS_PIN    34    // modem STATUS via level shifter powered by the modem's
                            // 1.8V rail: HIGH = on, FLOATING (not LOW) when off
#define BAT_ADC_PIN   35    // VBAT through 100K/100K divider → ×2
#define SOLAR_ADC_PIN 36    // solar input through 100K/100K divider → ×2
#define LED_PIN       12

// ── Network config ───────────────────────────────────────
const char APN[]  = "orangeworld";
const char USER[] = "orange";
const char PASS[] = "orange";

const char DEVICE_ID[] = SECRET_DEVICE_ID;   // also the MQTT username

// ── Tunables ─────────────────────────────────────────────
// Remote-configurable ones live in `cfg` (defaults in struct Config below).
#define CYCLE_DEADLINE_MS 240000UL // hard cap on the active window (OTA excluded)
#define CONFIG_WAIT_MS    2000     // for the retained config after subscribing
#define EMERGENCY_MIN_BATT_V         3.50     // below (twice in a row): leave the online loop...
#define EMERGENCY_LOWBATT_INTERVAL_S 300      // ...and report on wake cycles this long instead
#define EMERGENCY_LINK_FAIL_MS       180000UL // no publish for this long: power-cycle the modem
#define EMERGENCY_RETRY_S            30       // sleep before that retry
#define OTA_TIMEOUT_MS    420000UL // whole download; ~2-3 min expected at 115200 baud
#define OTA_MIN_BATT_V    3.60     // don't start a download on a weak cell
#define WDT_TIMEOUT_MS    180000   // longest single blocking step is ~75 s (TCP connect)
#define MODEM_OFF_SETTLE_MS 15000 // after CPOF, before a reboot that powers it on again
#define FW_VERSION        "0.5.0"

// Bench-only switches — keep both commented out in a deployed build.
// 90 s cycles regardless of the configured report_interval_s:
// #define BENCH_TEST_INTERVAL_S 90
// Never deep sleep: idle, then restart (board stays awake, USB serial usable):
// #define DEBUG_NO_SLEEP

HardwareSerial modemSerial(1);
TinyGsm        modem(modemSerial);
TinyGsmClient  gsmClient(modem, 0);   // MQTT
TinyGsmClient  otaClient(modem, 1);   // HTTP (global: TinyGSM keeps a pointer to it)
PubSubClient   mqtt(gsmClient);

// GSV summary per constellation (declared up here for Arduino's prototypes)
struct Sky { int view = -1, tracked = 0, maxSnr = 0; };

// Remote config: defaults until a retained devices/<id>/config is applied.
struct Config {
  uint32_t v = 0;                      // version of the applied config document
  uint32_t reportIntervalS = 1800;     // normal wake cadence
  uint32_t gpsTimeoutS = 90;           // max wait for a fix, from GPS start
  bool     emergency = false;          // mode: "normal" / "emergency"
  uint32_t emergencyIntervalS = 60;    // report cadence while in emergency mode
};
Config cfg;

uint32_t cycleStart;
bool deadlineExceeded() { return millis() - cycleStart > CYCLE_DEADLINE_MS; }

// ── Logging: Serial + RTC buffer (published to devices/<id>/log) ──
// One struct, so its address — and its contents — carry across builds.
#define LOG_MAGIC 0x4C4F4733
#define LOG_CHUNK 1000           // per MQTT message; SIM7600 CIPSEND max is 1500
struct RtcLog { uint32_t magic; size_t len; char buf[4096]; };
RTC_NOINIT_ATTR RtcLog rtcLog;

void logInit() {
  if (rtcLog.magic != LOG_MAGIC || rtcLog.len > sizeof(rtcLog.buf)) {
    rtcLog.magic = LOG_MAGIC;    // power-on: RTC memory holds garbage
    rtcLog.len = 0;
  }
}

void logAppend(const char *s, size_t n) {
  RtcLog &L = rtcLog;
  if (n > sizeof(L.buf) / 2) n = sizeof(L.buf) / 2;
  if (L.len + n > sizeof(L.buf)) {             // full: drop the oldest lines
    size_t drop = min(L.len, L.len + n - sizeof(L.buf) + 512);
    while (drop > 0 && drop < L.len && L.buf[drop - 1] != '\n') drop++;
    memmove(L.buf, L.buf + drop, L.len - drop);
    L.len -= drop;
  }
  memcpy(L.buf + L.len, s, n);
  L.len += n;
}

// Every line gets seconds-since-boot, so remote logs keep their timing.
void emit(const char *s, size_t n) {
  char ts[16];
  int tn = snprintf(ts, sizeof(ts), "%7.1f ", millis() / 1000.0);
  Serial.write((const uint8_t *)ts, tn); Serial.write((const uint8_t *)s, n); Serial.write('\n');
  logAppend(ts, tn); logAppend(s, n); logAppend("\n", 1);
}

void logln(const String &s) { emit(s.c_str(), s.length()); }
void logf(const char *fmt, ...) {
  char buf[256];
  va_list args; va_start(args, fmt);
  int n = vsnprintf(buf, sizeof(buf), fmt, args);
  va_end(args);
  if (n < 0) return;
  if (n >= (int)sizeof(buf)) n = sizeof(buf) - 1;
  if (n > 0 && buf[n - 1] == '\n') n--;
  emit(buf, n);
}

String topicFor(const char *leaf) { return String("devices/") + DEVICE_ID + "/" + leaf; }

// Publish the RTC log in ≤LOG_CHUNK pieces split at line ends; what was sent
// is dropped from the buffer. Must not log itself (it would append to it).
bool publishLog() {
  String topic = topicFor("log");
  size_t off = 0;
  bool ok = true;
  while (off < rtcLog.len) {
    size_t n = min((size_t)LOG_CHUNK, rtcLog.len - off);
    if (off + n < rtcLog.len)
      for (size_t i = n; i > 1; i--)
        if (rtcLog.buf[off + i - 1] == '\n') { n = i; break; }
    if (!mqtt.publish(topic.c_str(), (const uint8_t *)rtcLog.buf + off, n, false)) {
      ok = false;
      break;
    }
    off += n;
  }
  memmove(rtcLog.buf, rtcLog.buf + off, rtcLog.len - off);
  rtcLog.len -= off;
  return ok;
}

// ── Watchdog: a hung cycle resets the board (and rolls back a new build) ──
void wdtInit() {
  esp_task_wdt_config_t cfg = { .timeout_ms = WDT_TIMEOUT_MS, .idle_core_mask = 0,
                                .trigger_panic = true };
  esp_task_wdt_reconfigure(&cfg);
  esp_task_wdt_add(NULL);
}
void wdtFeed() { esp_task_wdt_reset(); }

const char *resetReason() {
  switch (esp_reset_reason()) {
    case ESP_RST_POWERON:   return "poweron";
    case ESP_RST_SW:        return "sw";
    case ESP_RST_PANIC:     return "panic";
    case ESP_RST_INT_WDT:   return "int_wdt";
    case ESP_RST_TASK_WDT:  return "task_wdt";
    case ESP_RST_WDT:       return "wdt";
    case ESP_RST_DEEPSLEEP: return "deepsleep";
    case ESP_RST_BROWNOUT:  return "brownout";
    case ESP_RST_EXT:       return "ext";
    default:                return "other";
  }
}

// ── Battery ──────────────────────────────────────────────
// Li-ion OCV → percent, rough but good enough for alerts.
int battPercent(float v) {
  if (v >= 4.20) return 100;
  if (v >= 4.06) return 90;
  if (v >= 3.98) return 80;
  if (v >= 3.92) return 70;
  if (v >= 3.87) return 60;
  if (v >= 3.82) return 50;
  if (v >= 3.79) return 40;
  if (v >= 3.77) return 30;
  if (v >= 3.74) return 20;
  if (v >= 3.68) return 10;
  if (v >= 3.45) return 5;
  return 0;
}

float readVolts(int pin) {
  return analogReadMilliVolts(pin) * 2.0 / 1000.0;   // 100K/100K divider
}

// ── Modem power control ─────────────────────────────────
bool modemIsOn = false;   // only trust power-off when we saw it come up

bool modemPowerOn() {
  pinMode(DTR_PIN, OUTPUT);
  digitalWrite(DTR_PIN, LOW);          // keep modem awake (no UART sleep)
  pinMode(STATUS_PIN, INPUT);

  // Already running? (ESP32 reset while the modem kept power, DIP 4 auto-on)
  if (modem.testAT(2000)) {
    modemIsOn = true;
    logln("[PWR] modem already on");
    return true;
  }

  // SIM7600: PWRKEY low ≥100 ms powers on, low ≥2.5 s powers off — so a
  // 1 s pulse is always an ON command, never a shutdown.
  for (int attempt = 1; attempt <= 2; attempt++) {
    logf("[PWR] PWRKEY pulse #%d, batt=%.2f V", attempt, readVolts(BAT_ADC_PIN));
    digitalWrite(PWRKEY_PIN, HIGH);    // NPN pulls PWRKEY low
    delay(1000);
    digitalWrite(PWRKEY_PIN, LOW);

    uint32_t t0 = millis();
    while (millis() - t0 < 30000) {    // power-on → AT ready takes ~10-20 s
      if (modem.testAT(5000)) {
        modemIsOn = true;
        logf("[PWR] modem up %lus after pulse #%d", (unsigned long)(millis() - t0) / 1000, attempt);
        return true;
      }
    }
  }

  logln("[PWR] modem did not power on");
  return false;
}

void modemPowerOff() {
  if (!modemIsOn) {                    // modem never came up — don't poke it
    logln("[PWR] modem never powered on, skipping power-off");
    return;
  }
  wdtFeed();
  modem.gprsDisconnect();
  modem.poweroff();                    // AT+CPOF
  // It keeps answering AT for a moment while shutting down; wait that out.
  uint32_t t0 = millis();
  while (millis() - t0 < 15000 && modem.testAT(1000)) delay(1000);
  modemIsOn = modem.testAT(1000);
  if (modemIsOn) {                     // fallback: PWRKEY low ≥2.5 s = power off
    logln("[PWR] CPOF failed, forcing PWRKEY power-off");
    digitalWrite(PWRKEY_PIN, HIGH); delay(3000); digitalWrite(PWRKEY_PIN, LOW);
    delay(5000);
    modemIsOn = modem.testAT(2000);
  }
  logln(modemIsOn ? "[PWR] modem FAILED to power off!" : "[PWR] modem OFF");
}

// ── GPS ──────────────────────────────────────────────────
// Raw reply of an AT command on one line (diagnostics).
String atRaw(const char *cmd, uint32_t timeoutMs = 2000) {
  String data;
  modem.sendAT(cmd);
  modem.waitResponse(timeoutMs, data);
  data.replace("\r", "");
  data.replace("\n", " ");
  data.trim();
  return data;
}

// gpsOneXTRA: satellite orbits downloaded over cellular (valid ~7 days), so
// the receiver needn't decode them from the sky — that takes ≥30 s of clean
// signal per satellite, which a cold start in a marginal spot rarely gets.
// CGPSXE is stored by the modem and takes effect from its next power-up.
// Needs the data connection, so it runs after GPRS and before GPS start.
#define XTRA_EVERY_CYCLES 48     // re-download about daily at 30 min cycles
RTC_DATA_ATTR uint32_t xtraAge = XTRA_EVERY_CYCLES;   // cycles since the last download

void gpsXtra() {
  String xe = atRaw("+CGPSXE?");
  if (xe.indexOf("+CGPSXE: 1") < 0) {
    logln("[GPS] XTRA off (" + xe + "), CGPSXE=1: " + atRaw("+CGPSXE=1") +
          " — takes effect from the next modem power-up");
    return;
  }
  if (xtraAge < XTRA_EVERY_CYCLES) { xtraAge++; return; }

  wdtFeed();
  uint32_t t0 = millis();
  String data;
  modem.sendAT(GF("+CGPSXD=0"));                    // OK now, +CGPSXD: <err> when done
  int8_t r = modem.waitResponse(60000L, data, GF("+CGPSXD:"));
  String code = r == 1 ? modemSerial.readStringUntil('\n') : "";
  code.trim();
  if (r == 1 && code == "0") xtraAge = 0;
  logf("[GPS] XTRA download %s in %lus (modem clock %s)", r == 1 ? ("result " + code).c_str()
       : r == 2 ? "ERROR" : "timeout", (unsigned long)(millis() - t0) / 1000,
       atRaw("+CCLK?").c_str());              // XTRA needs a correct clock (network time)
}

// The active GNSS antenna is biased from modem pin 44 (VDD_EXT / VREG_AUX1,
// LilyGO net VDD_3V through FB3), which AT+CVAUXS switches.
uint32_t gpsStartMs;
void gpsStart() {
  String bias = atRaw("+CVAUXS=1");          // on by default; make sure
  if (bias != "OK") logln("[GPS] antenna bias CVAUXS=1: " + bias);
  gpsXtra();
  gpsStartMs = millis();
  if (!modem.enableGPS()) logln("[GPS] start FAILED: CGPS? " + atRaw("+CGPS?"));
}

// i-th comma-separated field of an NMEA sentence (checksum stripped).
String nmeaField(const String &s, int idx) {
  int start = 0;
  for (int i = 0; i < idx; i++) {
    start = s.indexOf(',', start) + 1;
    if (start == 0) return "";
  }
  int end = s.indexOf(',', start);
  if (end < 0) end = s.indexOf('*', start);
  return s.substring(start, end < 0 ? s.length() : end);
}

void skyAdd(const String &s, Sky &gp, Sky &gl, int &used) {
  if (s.startsWith("$GPGSV") || s.startsWith("$GLGSV")) {
    Sky &k = s[2] == 'P' ? gp : gl;
    if (nmeaField(s, 2).toInt() == 1) k = Sky();   // first sentence of a new group
    k.view = nmeaField(s, 3).toInt();
    for (int f = 7; f <= 19; f += 4) {             // SNR of each of ≤4 satellites
      String snr = nmeaField(s, f);
      if (snr.length()) { k.tracked++; k.maxSnr = max(k.maxSnr, (int)snr.toInt()); }
    }
  } else if (s.startsWith("$GPGGA") || s.startsWith("$GNGGA")) {
    used = nmeaField(s, 7).toInt();
  }
}

// What the receiver hears while searching: nothing in view = antenna/sky
// problem; satellites with decent SNR (>30 dB) but no fix = slow cold start.
String gpsSky() {
  String ack;
  modem.sendAT(GF("+CGPSINFOCFG=1,69"));          // NMEA every 1 s: GPGGA|GPGSV|GLGSV
  if (modem.waitResponse(2000L, ack) != 1) {
    ack.replace("\r\n", " "); ack.trim();
    return "NMEA cfg failed: " + ack;
  }
  Sky gp, gl;
  int used = -1;
  String line;
  uint32_t t0 = millis();
  while (millis() - t0 < 2500) {
    while (modemSerial.available()) {
      char c = modemSerial.read();
      if (c == '\n') { skyAdd(line, gp, gl, used); line = ""; }
      else if (c != '\r' && line.length() < 120) line += c;
    }
    delay(5);
  }
  modem.sendAT(GF("+CGPSINFOCFG=0,69"));
  modem.waitResponse(2000L);
  delay(1200);                                     // drop sentences still in flight
  while (modemSerial.available()) modemSerial.read();
  char out[96];
  snprintf(out, sizeof(out), "GP %d in view, %d heard, max %d dB | GL %d, %d, %d dB | used %d",
           gp.view, gp.tracked, gp.maxSnr, gl.view, gl.tracked, gl.maxSnr, used);
  return out;
}

// One poll of the running receiver. acc is PDOP (TinyGSM's "accuracy"; it
// also leaves vsat/usat at 0 on the SIM7600).
bool gpsPoll(float &lat, float &lon, float &acc) {
  float speed, alt;
  int vsat, usat, year, month, day, hour, min, sec;
  return modem.getGPS(&lat, &lon, &speed, &alt, &vsat, &usat, &acc,
                      &year, &month, &day, &hour, &min, &sec);
}

bool getGpsFix(float &lat, float &lon, float &acc, uint32_t timeoutMs) {
  uint32_t lastSky = millis();                     // first sky report after 15 s without fix
  while (millis() - gpsStartMs < timeoutMs) {
    wdtFeed();
    if (deadlineExceeded()) break;
    if (gpsPoll(lat, lon, acc)) {
      logf("[GPS] fix after %lus, pdop %.1f", (unsigned long)(millis() - gpsStartMs) / 1000, acc);
      modem.disableGPS();
      return true;
    }
    if (millis() - lastSky >= 15000) {
      lastSky = millis();
      logf("[GPS] %3lus: %s", (unsigned long)(millis() - gpsStartMs) / 1000, gpsSky().c_str());
    }
    delay(1000);
  }
  modem.disableGPS();
  return false;
}

// ── OTA ──────────────────────────────────────────────────
// NVS "ota": try = build being installed; bad/fails = build that got rolled back.
Preferences otaPrefs;
bool   onProbation = false;   // running a fresh OTA build that hasn't published yet
String otaNote;               // reported in telemetry: what OTA last did

// Keep the core from confirming a fresh OTA image at boot; otaConfirm() does
// it once this build has proven it can publish.
extern "C" bool verifyRollbackLater() { return true; }

void otaBootCheck() {
  esp_ota_img_states_t st;
  onProbation = esp_ota_get_state_partition(esp_ota_get_running_partition(), &st) == ESP_OK
                && st == ESP_OTA_IMG_PENDING_VERIFY;
  otaPrefs.begin("ota", false);
  if (onProbation) logln("[OTA] new build on probation until it publishes");

  String tried = otaPrefs.isKey("try") ? otaPrefs.getString("try") : "";
  if (tried.length() && tried != FW_BUILD) {
    // We are the previous build again: the one we installed was rolled back.
    String bad = otaPrefs.isKey("bad") ? otaPrefs.getString("bad") : "";
    uint8_t fails = (bad == tried ? otaPrefs.getUChar("fails", 0) : 0) + 1;
    otaPrefs.putString("bad", tried);
    otaPrefs.putUChar("fails", fails);
    otaPrefs.remove("try");
    otaNote = "rolled back " + tried;
    logf("[OTA] build %s was rolled back (failure #%d)", tried.c_str(), fails);
  }
}

void otaConfirm() {
  if (onProbation) {
    esp_ota_mark_app_valid_cancel_rollback();
    onProbation = false;
    otaNote = "confirmed";
    logln("[OTA] new build confirmed");
  }
  if (otaPrefs.isKey("try")) {
    otaPrefs.remove("try");
    otaPrefs.remove("bad");
    otaPrefs.remove("fails");
  }
}

String manifestField(const String &m, const char *key) {
  String k = String(key) + "=";
  int i = m.startsWith(k) ? 0 : m.indexOf("\n" + k);
  if (i < 0) return "";
  if (i > 0) i++;
  i += k.length();
  int e = m.indexOf('\n', i);
  String v = m.substring(i, e < 0 ? m.length() : e);
  v.trim();
  return v;
}

// Pull manifest.txt; if it names another build, install it. Returns true when
// a new image is ready to boot (the caller powers the modem off and restarts).
bool otaCheck() {
  HttpClient http(otaClient, SECRET_OTA_HOST, SECRET_OTA_PORT);
  const String base = String("/fw/") + SECRET_OTA_TOKEN + "/";

  if (http.get(base + "manifest.txt") != 0 || http.responseStatusCode() != 200) {
    logln("[OTA] manifest fetch failed");
    http.stop();
    return false;
  }
  String m = http.responseBody();
  http.stop();

  String version = manifestField(m, "version");
  String file    = manifestField(m, "file");
  long   size    = manifestField(m, "size").toInt();
  String md5     = manifestField(m, "md5");
  if (!version.length() || !file.length() || size <= 0 || md5.length() != 32) {
    logln("[OTA] manifest malformed");
    return false;
  }
  if (version == FW_BUILD) {
    logln("[OTA] up to date");
    return false;
  }
  if (otaPrefs.isKey("bad") && otaPrefs.getString("bad") == version &&
      otaPrefs.getUChar("fails", 0) >= 2) {
    logf("[OTA] skipping %s: rolled back twice", version.c_str());
    return false;
  }

  logf("[OTA] %s -> %s (%ld bytes), downloading", FW_BUILD, version.c_str(), size);
  uint32_t t0 = millis();
  if (http.get(base + file) != 0 || http.responseStatusCode() != 200 ||
      http.contentLength() != size) {
    logln("[OTA] image request failed");
    http.stop();
    return false;
  }
  if (!Update.begin(size)) {
    logf("[OTA] Update.begin: %s", Update.errorString());
    http.stop();
    return false;
  }
  Update.setMD5(md5.c_str());

  static uint8_t buf[1024];
  long got = 0;
  int quarter = -1;
  uint32_t lastData = millis();
  while (got < size) {
    wdtFeed();
    if (millis() - lastData > 30000 || millis() - t0 > OTA_TIMEOUT_MS) break;
    int n = http.read(buf, min((long)sizeof(buf), size - got));
    if (n > 0) {
      if (Update.write(buf, n) != (size_t)n) break;
      got += n;
      lastData = millis();
      if (got * 4 / size != quarter) {
        quarter = got * 4 / size;
        logf("[OTA] %ld/%ld bytes, %lus", got, size, (unsigned long)(millis() - t0) / 1000);
      }
    } else if (!http.connected()) {
      break;
    } else {
      delay(10);
    }
  }
  http.stop();

  if (got != size || !Update.end()) {  // end() verifies the MD5 and the image
    logf("[OTA] failed at %ld/%ld bytes: %s", got, size, Update.errorString());
    Update.abort();
    otaNote = "failed " + version;
    return false;
  }
  otaPrefs.putString("try", version);
  float secs = max((millis() - t0) / 1000.0f, 1.0f);
  logf("[OTA] installed %s in %.0fs (%.1f KB/s), rebooting into it",
       version.c_str(), secs, size / 1024.0f / secs);
  return true;
}

// ── Remote config ────────────────────────────────────────
// devices/<id>/config holds one retained JSON document, e.g.
//   {"v":3,"report_interval_s":1800,"gps_timeout_s":90,"mode":"normal","emergency_interval_s":60}
// "v" must change for a document to be applied; absent keys keep their value.
// A document with any invalid value is rejected as a whole.
Preferences cfgPrefs;
String pendingConfig;                  // copied out of the MQTT callback...
bool   gotConfig = false;              // ...and applied outside it (publish reuses the buffer)
RTC_DATA_ATTR uint32_t cfgRejectedV = 0;   // ack a rejected version only once

void cfgLoad() {
  cfgPrefs.begin("cfg", false);
  cfg.v                  = cfgPrefs.getUInt("v", cfg.v);
  cfg.reportIntervalS    = cfgPrefs.getUInt("report", cfg.reportIntervalS);
  cfg.gpsTimeoutS        = cfgPrefs.getUInt("gps", cfg.gpsTimeoutS);
  cfg.emergency          = cfgPrefs.getBool("emg", cfg.emergency);
  cfg.emergencyIntervalS = cfgPrefs.getUInt("emgint", cfg.emergencyIntervalS);
  logf("[CFG] v%u: report %us, gps %us, mode %s, emergency every %us", cfg.v,
       cfg.reportIntervalS, cfg.gpsTimeoutS, cfg.emergency ? "emergency" : "normal",
       cfg.emergencyIntervalS);
}

void cfgSave() {
  cfgPrefs.putUInt("v", cfg.v);
  cfgPrefs.putUInt("report", cfg.reportIntervalS);
  cfgPrefs.putUInt("gps", cfg.gpsTimeoutS);
  cfgPrefs.putBool("emg", cfg.emergency);
  cfgPrefs.putUInt("emgint", cfg.emergencyIntervalS);
}

void applyConfig(const String &json) {
  if (json.length() == 0) return;      // retained config deleted: keep what we have
  JsonDocument doc;
  uint32_t v = 0;
  String err;
  if (deserializeJson(doc, json)) {
    err = "invalid JSON";
  } else {
    v = doc["v"] | 0u;
    if (v == cfg.v || v == cfgRejectedV) return;   // already applied / already refused
  }

  Config n = cfg;
  auto num = [&](const char *key, uint32_t &dst, uint32_t lo, uint32_t hi) {
    JsonVariant x = doc[key];
    if (x.isNull() || err.length()) return;
    if (!x.is<uint32_t>() || x.as<uint32_t>() < lo || x.as<uint32_t>() > hi)
      err = String(key) + " must be " + lo + ".." + hi;
    else
      dst = x.as<uint32_t>();
  };
  if (!err.length()) {
    num("report_interval_s",    n.reportIntervalS,    60, 86400);
    num("gps_timeout_s",        n.gpsTimeoutS,        10, 180);
    num("emergency_interval_s", n.emergencyIntervalS, 10, 3600);
    JsonVariant m = doc["mode"];
    if (!m.isNull() && !err.length()) {
      if (m == "normal")         n.emergency = false;
      else if (m == "emergency") n.emergency = true;
      else                       err = "mode must be normal or emergency";
    }
  }

  JsonDocument ack;
  ack["v"] = v;
  ack["ok"] = !err.length();
  if (err.length()) {
    cfgRejectedV = v;
    ack["error"] = err;
    logf("[CFG] v%u rejected: %s", v, err.c_str());
  } else {
    n.v = v;
    cfg = n;
    cfgSave();
    ack["report_interval_s"] = cfg.reportIntervalS;
    ack["gps_timeout_s"] = cfg.gpsTimeoutS;
    ack["mode"] = cfg.emergency ? "emergency" : "normal";
    ack["emergency_interval_s"] = cfg.emergencyIntervalS;
    logf("[CFG] applied v%u: report %us, gps %us, mode %s, emergency every %us", cfg.v,
         cfg.reportIntervalS, cfg.gpsTimeoutS, cfg.emergency ? "emergency" : "normal",
         cfg.emergencyIntervalS);
  }
  String out;
  serializeJson(ack, out);
  mqtt.publish(topicFor("ack").c_str(), out.c_str());
}

// ── MQTT ─────────────────────────────────────────────────
void onMqtt(char *topic, uint8_t *payload, unsigned int len) {
  if (topicFor("config") != topic) return;
  pendingConfig = "";
  pendingConfig.reserve(len);
  for (unsigned int i = 0; i < len; i++) pendingConfig += (char)payload[i];
  gotConfig = true;
}

// Connect and subscribe to the config (the retained document follows the SUBACK).
bool mqttConnect() {
  mqtt.setServer(SECRET_MQTT_HOST, SECRET_MQTT_PORT);
  mqtt.setSocketTimeout(15);
  mqtt.setBufferSize(LOG_CHUNK + 128);
  mqtt.setCallback(onMqtt);
  if (!mqtt.connect(DEVICE_ID, DEVICE_ID, SECRET_MQTT_PASS)) return false;
  if (!mqtt.subscribe(topicFor("config").c_str())) logln("[CFG] subscribe failed");
  return true;
}

// Apply the retained config if it arrives within CONFIG_WAIT_MS.
void fetchConfig() {
  uint32_t t0 = millis();
  while (!gotConfig && millis() - t0 < CONFIG_WAIT_MS && mqtt.connected()) {
    mqtt.loop();
    delay(10);
  }
  if (gotConfig) { gotConfig = false; applyConfig(pendingConfig); }
}

String telemetry(bool gpsOk, float lat, float lon, float acc, float battV, float solarV,
                 const char *reason, bool lastGasp) {
  return String("{\"lat\":")    + (gpsOk ? String(lat, 6) : "null") +
         ",\"lon\":"            + (gpsOk ? String(lon, 6) : "null") +
         ",\"acc_m\":"          + (gpsOk ? String(acc, 0) : "null") +
         ",\"batt_v\":"         + String(battV, 2) +
         ",\"batt_pct\":"       + String(battPercent(battV)) +
         ",\"solar_v\":"        + String(solarV, 2) +
         ",\"signal\":"         + String(modem.getSignalQuality()) +
         ",\"mode\":\""         + (cfg.emergency ? "emergency" : "normal") + "\"" +
         ",\"reason\":\""       + reason + "\"" +
         ",\"last_gasp\":"      + (lastGasp ? "true" : "false") +
         ",\"cfg_v\":"          + String(cfg.v) +
         ",\"fw\":\""           + FW_VERSION + "\"" +
         ",\"build\":\""        + FW_BUILD + "\"" +
         ",\"boot\":\""         + resetReason() + "\"" +
         (otaNote.length() ? ",\"ota\":\"" + otaNote + "\"" : "") + "}";
}

// ── Emergency mode ───────────────────────────────────────
// Stay online with the receiver running (fixes in ~1 s) and report every
// emergencyIntervalS. Config changes arrive live, so clearing the mode ends
// the loop within seconds. Returns how long to sleep afterwards.
float battAverage() {
  uint32_t mv = 0;
  for (int i = 0; i < 8; i++) mv += analogReadMilliVolts(BAT_ADC_PIN);
  return mv / 8 * 2.0 / 1000.0;          // 100K/100K divider
}

uint32_t emergencyLoop(float solarV) {
  logf("[EMG] emergency mode: reporting every %us", cfg.emergencyIntervalS);
  modem.enableGPS();
  uint32_t lastReport = millis();        // the cycle's own report just went out
  uint32_t downSince = 0;                // 0 = MQTT connected
  uint32_t reports = 0;
  int lowBatt = 0;
  String topic = topicFor("telemetry");

  while (true) {
    wdtFeed();
    mqtt.loop();
    if (gotConfig) { gotConfig = false; applyConfig(pendingConfig); }
    if (!cfg.emergency) {
      logf("[EMG] cleared after %u reports", reports);
      modem.disableGPS();
      return cfg.reportIntervalS;
    }
    if (!mqtt.connected()) {
      if (!downSince) {
        downSince = millis() | 1;
        logln("[EMG] MQTT connection lost, reconnecting");
      }
      if (millis() - downSince > EMERGENCY_LINK_FAIL_MS) {
        logln("[EMG] still offline, power-cycling the modem");
        modem.disableGPS();
        return EMERGENCY_RETRY_S;
      }
      if (!modem.isGprsConnected()) {
        wdtFeed();
        modem.gprsConnect(APN, USER, PASS);
      }
      wdtFeed();
      if (!mqttConnect()) { delay(5000); continue; }
      logf("[EMG] reconnected after %lus", (unsigned long)(millis() - downSince) / 1000);
      downSince = 0;
    }

    if (millis() - lastReport >= cfg.emergencyIntervalS * 1000UL) {
      lastReport = millis();
      float battV = battAverage();
      bool onUsb = battV < 1.0;
      lowBatt = (!onUsb && battV < EMERGENCY_MIN_BATT_V) ? lowBatt + 1 : 0;
      if (lowBatt >= 2) {
        logf("[EMG] battery %.2f V: falling back to %us wake cycles", battV,
             EMERGENCY_LOWBATT_INTERVAL_S);
        modem.disableGPS();
        return EMERGENCY_LOWBATT_INTERVAL_S;
      }
      float lat = 0, lon = 0, acc = 0;
      bool fix = gpsPoll(lat, lon, acc);
      String payload = telemetry(fix, lat, lon, acc, battV, solarV, "emergency", false);
      if (mqtt.publish(topic.c_str(), payload.c_str())) {
        if (reports++ % 10 == 0)         // keep the log light: every 10th report
          logf("[EMG] report #%u: fix=%d batt=%.2f V", reports, fix, battV);
        publishLog();
      } else {
        logln("[EMG] publish failed");
      }
    }
    delay(50);
  }
}

// ── One full cycle ───────────────────────────────────────
void setup() {
  Serial.begin(115200);
  logInit();
  wdtInit();
  analogReadResolution(12);

  pinMode(PWRKEY_PIN, OUTPUT);
  digitalWrite(PWRKEY_PIN, LOW);       // NPN off → PWRKEY released
  pinMode(LED_PIN, OUTPUT);
  modemSerial.begin(115200, SERIAL_8N1, MODEM_RX_PIN, MODEM_TX_PIN);

  cycleStart = millis();
  logf("[BOOT] reset=%s wake=%d fw=%s build=%s slot=%s", resetReason(),
       (int)esp_sleep_get_wakeup_cause(), FW_VERSION, FW_BUILD,
       esp_ota_get_running_partition()->label);
  otaBootCheck();
  cfgLoad();

  // Battery BEFORE powering the modem (resting voltage, no TX sag)
  float battV = readVolts(BAT_ADC_PIN);
  float solarV = readVolts(SOLAR_ADC_PIN);
  logf("[BAT] %.2f V (%d%%)  solar %.2f V", battV, battPercent(battV), solarV);

  const char *reason = "timer";
  uint32_t sleepS = 0;                 // 0: decided at the end, from the (maybe updated) config
  bool skipGps = false;
  bool lastGasp = false;

  // DEBUG build: tag the report so bench publishes are recognisable.
#ifdef DEBUG_NO_SLEEP
  reason = "debug";
#endif

  // Battery policy: protect the cell, but never die silently.
  // With USB VBUS present the battery is switched off the ADC node (Q7), which
  // then reads ~0.28 V — that's "on USB", not a flat cell.
  bool onUsb = battV < 1.0;
  if (onUsb) {
    logln("[BAT] no reading (USB powered) — battery policy skipped");
  } else if (battV < 3.30) {
    skipGps = true; lastGasp = true;
    sleepS = 6 * 3600;                          // hibernate between last gasps
    logln("[BAT] CRITICAL — last-gasp report, then 6h sleep");
  } else if (battV < 3.50) {
    skipGps = true;                             // low: report without GPS
    logln("[BAT] LOW — skipping GPS this cycle");
  }

  bool networkOk = false, gpsOk = false, published = false, otaReady = false;
  float lat = 0, lon = 0, acc = 0;

  if (modemPowerOn()) {
    wdtFeed();
    if (!modem.init()) logln("[PWR] modem.init() failed (SIM not ready?)");
    logln("[PWR] modem: " + modem.getModemInfo());
    logln("[NET] waiting for network...");
    if (modem.waitForNetwork(min(60000UL, CYCLE_DEADLINE_MS - (millis() - cycleStart)))) {
      networkOk = true;
      logln("[NET] ok, signal: " + String(modem.getSignalQuality()));
      wdtFeed();

      if (modem.gprsConnect(APN, USER, PASS)) {
        logln("[NET] GPRS ok, IP: " + modem.localIP().toString());

        if (!skipGps && !deadlineExceeded()) {
          gpsStart();
          logln("[GPS] waiting for fix...");
          gpsOk = getGpsFix(lat, lon, acc, cfg.gpsTimeoutS * 1000UL);
          logln(gpsOk
            ? "[GPS] fix: " + String(lat, 6) + ", " + String(lon, 6) + " (acc " + String(acc, 0) + "m)"
            : "[GPS] no fix (timeout)");
        }

        wdtFeed();
        if (!deadlineExceeded()) {
          if (mqttConnect()) {
            String payload = telemetry(gpsOk, lat, lon, acc, battV, solarV, reason, lastGasp);
            published = mqtt.publish(topicFor("telemetry").c_str(), payload.c_str());
            logln(published ? "[MQTT] published: " + payload
                            : "[MQTT] publish failed");
            if (published) otaConfirm();
            fetchConfig();
            if (cfg.emergency && !lastGasp) {
              if (onUsb || battV >= EMERGENCY_MIN_BATT_V)
                sleepS = emergencyLoop(solarV);
              else
                logf("[EMG] battery %.2f V: wake cycles instead of staying online", battV);
            }
            publishLog();
            mqtt.disconnect();
          } else {
            logln("[MQTT] connect failed, state " + String(mqtt.state()));
          }
        }

        // Self-update only from a deployed build, after a successful publish
        // (so a broken network path can't strand us mid-download), and never
        // in emergency mode.
        if (published && !cfg.emergency && strcmp(FW_BUILD, "dev") != 0) {
          if (onUsb || battV >= OTA_MIN_BATT_V) {
            wdtFeed();
            otaReady = otaCheck();
          } else {
            logf("[OTA] skipped: battery %.2f V < %.2f V", battV, OTA_MIN_BATT_V);
          }
        }
      } else {
        logln("[NET] GPRS failed");
      }
    } else {
      logln("[NET] no network");
    }
  } else {
    logln("[PWR] modem did not power on!");
  }

  logf("[CYCLE] net=%d gps=%d pub=%d ota=%d emg=%d %lus", networkOk, gpsOk, published,
       otaReady, cfg.emergency, (unsigned long)(millis() - cycleStart) / 1000);
  modemPowerOff();

  // Immediate reboots: the modem stops answering AT before it has finished
  // shutting down, and ignores a PWRKEY pulse until it has — so let it settle.
  if (onProbation) {                   // new build couldn't publish: give it up
    logln("[OTA] new build failed its first cycle — rolling back");
    Serial.flush(); delay(MODEM_OFF_SETTLE_MS);
    esp_ota_mark_app_invalid_rollback_and_reboot();
  }
  if (otaReady) {                      // boot the new build right away
    Serial.flush(); delay(MODEM_OFF_SETTLE_MS);
    esp_restart();
  }

  if (sleepS == 0)                     // emergency without the online loop: wake often
    sleepS = cfg.emergency ? min(cfg.reportIntervalS, (uint32_t)EMERGENCY_LOWBATT_INTERVAL_S)
                           : cfg.reportIntervalS;
#ifdef BENCH_TEST_INTERVAL_S
  if (!lastGasp) sleepS = min(sleepS, (uint32_t)BENCH_TEST_INTERVAL_S);   // bench cap
#endif

  digitalWrite(LED_PIN, published ? HIGH : LOW);
  delay(published ? 200 : 1200);
  digitalWrite(LED_PIN, LOW);

#ifdef DEBUG_NO_SLEEP
  // Debug idle (stands in for deep sleep), then restart for the next cycle.
  logf("[DEBUG] idle %us instead of deep sleep", sleepS);
  uint32_t idleStart = millis();
  while (millis() - idleStart < sleepS * 1000UL) {
    wdtFeed();
    delay(200);
  }
  logf("[DEBUG] batt %.2f V, restarting for next cycle", readVolts(BAT_ADC_PIN));
  Serial.flush(); delay(100);
  esp_restart();
#else
  logf("[SLEEP] deep sleep for %us", sleepS);
  Serial.flush(); delay(100);
  esp_sleep_enable_timer_wakeup((uint64_t)sleepS * 1000000ULL);
  esp_deep_sleep_start();   // never returns; wake re-enters setup()
#endif
}

void loop() {}
